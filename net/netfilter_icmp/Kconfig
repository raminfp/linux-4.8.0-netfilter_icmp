## net/netfilter_icmp/Kconfig
```kconfig
#
# Samples  - configuration
#
config NETFILTER_ICMP
        bool "NETFILTER ICMP"
        default y
        ---help---
        NETFILTER ICMP - This is a test - Sample Code
```
